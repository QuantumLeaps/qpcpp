## zephyr/Kconfig
```kconfig
# QPCPP Zephyr module
# SPDX-License-Identifier: GPL-3.0-or-later OR LicenseRef-QL-commercial

menuconfig QPCPP
    bool "QPCPP"
    default n
    help
        Enables the QPCPP Module

if QPCPP

config QSPY
    bool "QSPY Tracing"
    default n
    help
      Enables the QSPY Tracing for QP

module = QPCPP
module-str = QPCPP

endif
```
